/*
 * 日志:2021/4/5
 * 作者:夏瑜鸿(one of 搬砖打工人)
 * 功能:
 * 1.调用WiFiManager库手动智能配网
 * 2.接入NTP时钟服务器，并且可通过OLED屏显示时间
 * 3.接入巴法云服务器，订阅"Button"主题，在该主题下，
 *   可收到闹钟锁定的时间和线上购物的客户信息
 * 4.可支持和Arduino Mega板的串口通信，将传来的信息
 *   写入串口从而传输到主控中，然后在主控中进一步处理
 *   
 * 纠正了一个Bug:
 * 将执行"把字符串4和5送入mega板串口中"这一动作的代码从loop函数中移除，
 * 写在了doTCPClientTick函数中（具体见:494,496行），该函数可处理"Button"主题下的接收缓存，
 * 该函数内部收数据的逻辑一经触发，只执行一次，即可将字符串数据写入mega板的串口中，
 * 所以，mega板中的条件语句只会成立一次，将"原来数据在串口中持续发送，mega板程序中条件语句一直成立"的Bug成功解决
 */
#include<ESP8266WiFi.h>
#include<WiFiClient.h>
#include <Ticker.h>
#include<SoftwareSerial.h>
#include <NTPClient.h>
#include <WiFiUdp.h>
#include<Wire.h>//IIC通信库
#include <Adafruit_GFX.h>//OLED图形库
#include <Adafruit_SSD1306.h>//OLED主控芯片库
#include <DNSServer.h>//域名服务器库
#include <ESP8266WebServer.h>//网络服务器库
#include <WiFiManager.h>//专用配网库


#define OLED_RESET LED_BUILTIN  //43
#if (SSD1306_LCDHEIGHT != 64)
#error("Height incorrect, please fix Adafruit_SSD1306.h!");
#endif

WiFiClient TCPclient;
SoftwareSerial esp_Serial(D6,D7); //Tx,Rx
WiFiUDP NTP_Time;
NTPClient timeClient(NTP_Time,"ntp1.aliyun.com",60*60*8, 30*60*1000); 
Ticker loop_1;
Adafruit_SSD1306 display(OLED_RESET);




//巴法云服务器地址默认即可
#define TCP_SERVER_ADDR "bemfa.com"
//服务器端口，tcp创客云端口8344
#define TCP_SERVER_PORT "8344"
//最大字节数
#define MAX_PACKETSIZE 512
//设置心跳值30s
#define KEEPALIVEATIME 30*1000
//设置上传速率2s（1s<=upDataTime<=60s）
#define upDataTime 1*1000


String UID = "5e5064495edf833d79cdfd030291460d";  //用户私钥，可在控制台获取,修改为自己的UID
String TOPIC =   "Button";         //主题名字，可在控制台新建


 

String TcpClient_Buff = "";
unsigned int TcpClient_BuffIndex = 0;
unsigned long TcpClient_preTick = 0;
unsigned long preHeartTick = 0;//心跳
unsigned long preTCPStartTick = 0;//连接
bool preTCPConnected = false;

int Hour,Minute,Second;
int counter_1;
String h,m,s;
int H,M,S;
int state = 0;
String String_pub = "";
String Name,Floor;

static const unsigned char PROGMEM str_0[] =//0
{
  /*--  宽度x高度=16x32  --*/
0x3F,0xFE,0xFF,0xFF,0xFF,0xFF,0xFF,0xFF,0xFF,0xFF,0xF0,0x0F,0xF0,0x0F,0xF0,0x0F,
0xF0,0x0F,0xF0,0x0F,0xF0,0x0F,0xF0,0x0F,0xF0,0x0F,0xF0,0x0F,0xF0,0x0F,0xE0,0x03,
0x40,0x01,0xE0,0x07,0xF0,0x0F,0xF0,0x0F,0xF0,0x0F,0xF0,0x0F,0xF0,0x0F,0xF0,0x0F,
0xF0,0x0F,0xF0,0x0F,0xF0,0x0F,0xF0,0x0F,0xFF,0xFF,0xFF,0xFF,0xFF,0xFF,0xFF,0xFF
};
static const unsigned char PROGMEM str_1[] =//1
{
  /*--  宽度x高度=16x32  --*/
0x00,0x01,0x00,0x03,0x00,0x07,0x00,0x0F,0x00,0x0F,0x00,0x0F,0x00,0x0F,0x00,0x0F,
0x00,0x0F,0x00,0x0F,0x00,0x0F,0x00,0x0F,0x00,0x0F,0x00,0x0F,0x00,0x0F,0x00,0x03,
0x00,0x03,0x00,0x0F,0x00,0x0F,0x00,0x0F,0x00,0x0F,0x00,0x0F,0x00,0x0F,0x00,0x0F,
0x00,0x0F,0x00,0x0F,0x00,0x0F,0x00,0x0F,0x00,0x0F,0x00,0x07,0x00,0x03,0x00,0x00
};
static const unsigned char PROGMEM str_2[] =//2
{
  /*--  宽度x高度=16x32  --*/
0x7F,0xFF,0x7F,0xFF,0x3F,0xFF,0x1F,0xFF,0x00,0x0F,0x00,0x0F,0x00,0x0F,0x00,0x0F,
0x00,0x0F,0x00,0x0F,0x00,0x0F,0x00,0x0F,0x00,0x0F,0x00,0x0F,0x1F,0xFF,0x3F,0xFF,
0x7F,0xFE,0xFF,0xFC,0xFF,0xF8,0xF0,0x00,0xF0,0x00,0xF0,0x00,0xF0,0x00,0xF0,0x00,
0xF0,0x00,0xF0,0x00,0xF0,0x00,0xF0,0x00,0xFF,0xF8,0xFF,0xFC,0xFF,0xFE,0xFF,0xFF
};
static const unsigned char PROGMEM str_3[] =//3
{
 /*--  宽度x高度=16x32  --*/
0x7F,0xFF,0x7F,0xFF,0x3F,0xFF,0x1F,0xFF,0x0F,0xFF,0x00,0x0F,0x00,0x0F,0x00,0x0F,
0x00,0x0F,0x00,0x0F,0x00,0x0F,0x00,0x0F,0x00,0x0F,0x00,0x0F,0x0F,0xFF,0x1F,0xFF,
0x3F,0xFF,0x3F,0xFF,0x0F,0xFF,0x00,0x0F,0x00,0x0F,0x00,0x0F,0x00,0x0F,0x00,0x0F,
0x00,0x0F,0x00,0x0F,0x00,0x0F,0x00,0x0F,0x00,0x0F,0x1F,0xFF,0x3F,0xFF,0x7F,0xFF
};
static const unsigned char PROGMEM str_4[] =//4
{
  /*--  宽度x高度=16x32  --*/
0x00,0x00,0x60,0x01,0x70,0x03,0x78,0x07,0x78,0x0F,0x78,0x0F,0x78,0x0F,0x78,0x0F,
0x78,0x0F,0x78,0x0F,0x78,0x0F,0x78,0x0F,0x78,0x0F,0x78,0x0F,0x7F,0xFF,0x7F,0xFF,
0x3F,0xFF,0x1F,0xFF,0x0F,0xFF,0x00,0x0F,0x00,0x0F,0x00,0x0F,0x00,0x0F,0x00,0x0F,
0x00,0x0F,0x00,0x0F,0x00,0x0F,0x00,0x0F,0x00,0x0F,0x00,0x07,0x00,0x03,0x00,0x01
};
static const unsigned char PROGMEM str_5[] =//5
{
  /*--  宽度x高度=16x32  --*/
0x3F,0xFF,0x7F,0xFF,0x7F,0xFE,0x7F,0xFC,0x7F,0xF8,0x78,0x00,0x78,0x00,0x78,0x00,
0x78,0x00,0x78,0x00,0x78,0x00,0x78,0x00,0x78,0x00,0x78,0x00,0x7F,0xFC,0x7F,0xFE,
0x1F,0xFF,0x1F,0xFF,0x0F,0xFF,0x00,0x07,0x00,0x07,0x00,0x07,0x00,0x07,0x00,0x07,
0x00,0x07,0x00,0x07,0x00,0x07,0x00,0x07,0x0F,0xFF,0x1F,0xFF,0x1F,0xFF,0x3F,0xFF
};
static const unsigned char PROGMEM str_6[] =//6
{
  /*--  宽度x高度=16x32  --*/
0x3F,0xFE,0xFF,0xFF,0xFF,0xFE,0xFF,0xFC,0xFF,0xF8,0xF0,0x00,0xF0,0x00,0xF0,0x00,
0xF0,0x00,0xF0,0x00,0xF0,0x00,0xF0,0x00,0xF0,0x00,0xF0,0x00,0xFF,0xF8,0xFF,0xFE,
0x7F,0xFF,0xFF,0xFF,0xFF,0xFF,0xF0,0x0F,0xF0,0x0F,0xF0,0x0F,0xF0,0x0F,0xF0,0x0F,
0xF0,0x0F,0xF0,0x0F,0xF0,0x0F,0xF0,0x0F,0xFF,0xFF,0xFF,0xFF,0xFF,0xFF,0xFF,0xFF
};
static const unsigned char PROGMEM str_7[] =//7
{
  /*--  宽度x高度=16x32  --*/
0x3F,0xFE,0x7F,0xFF,0x3F,0xFF,0x1F,0xFF,0x1F,0xFF,0x00,0x0F,0x00,0x0F,0x00,0x0F,
0x00,0x0F,0x00,0x0F,0x00,0x0F,0x00,0x0F,0x00,0x0F,0x00,0x0F,0x00,0x0F,0x00,0x07,
0x00,0x03,0x00,0x03,0x00,0x0F,0x00,0x0F,0x00,0x0F,0x00,0x0F,0x00,0x0F,0x00,0x0F,
0x00,0x0F,0x00,0x0F,0x00,0x0F,0x00,0x0F,0x00,0x0F,0x00,0x0F,0x00,0x07,0x00,0x03
};
static const unsigned char PROGMEM str_8[] =//8
{
  /*--  宽度x高度=16x32  --*/
0x3F,0xFE,0xFF,0xFF,0xFF,0xFF,0xFF,0xFF,0xFF,0xFF,0xF0,0x07,0xF0,0x07,0xF0,0x07,
0xF0,0x07,0xF0,0x07,0xF0,0x07,0xF0,0x07,0xF0,0x07,0xF0,0x07,0xFF,0xFF,0xFF,0xFF,
0x7F,0xFF,0xFF,0xFF,0xFF,0xFF,0xF0,0x07,0xF0,0x07,0xF0,0x07,0xF0,0x07,0xF0,0x07,
0xF0,0x07,0xF0,0x07,0xF0,0x07,0xF0,0x07,0xFF,0xFF,0xFF,0xFF,0xFF,0xFF,0xFF,0xFF
};
static const unsigned char PROGMEM str_9[] =//9
{
  /*--  宽度x高度=16x32  --*/
0x7F,0xFF,0xFF,0xFF,0xFF,0xFF,0xFF,0xFF,0xF0,0x0F,0xF0,0x0F,0xF0,0x0F,0xF0,0x0F,
0xF0,0x0F,0xF0,0x0F,0xF0,0x0F,0xF0,0x0F,0xF0,0x0F,0xF0,0x0F,0xFF,0xFF,0xFF,0xFF,
0x7F,0xFF,0x1F,0xFF,0x00,0x0F,0x00,0x0F,0x00,0x0F,0x00,0x0F,0x00,0x0F,0x00,0x0F,
0x00,0x0F,0x00,0x0F,0x00,0x0F,0x00,0x0F,0x1F,0xFF,0x3F,0xFF,0x7F,0xFF,0x7F,0xFF
};
static const unsigned char PROGMEM str_10[] =//:
{
  /*--  宽度x高度=8x16  --*/
0x3C,0x3C,0x3C,0x3C,0x00,0x00,0x00,0x00,0x00,0x00,0x00,0x00,0x3C,0x3C,0x3C,0x3C
};
static const unsigned char PROGMEM str_11[] =//开机图标
{
  /*--  宽度x高度=128x64  --*/
0x07,0xFF,0xFF,0xFF,0xFF,0xFF,0xFF,0xFF,0xFF,0xFF,0xFF,0xFF,0xFF,0xFF,0xFF,0xC0,
0x1F,0xFF,0xFF,0xFF,0xFF,0xFF,0xFF,0xFF,0xFF,0xFF,0xFF,0xFF,0xFF,0xFF,0xFF,0xF0,
0x7F,0xFF,0xFF,0xFF,0xFF,0xFF,0xFF,0xFF,0xFF,0xFF,0xFF,0xFF,0xFF,0xFF,0xFF,0xF8,
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0x1F,0xFF,0xFF,0xFF,0xFF,0xFF,0xFF,0xFF,0xFF,0xFF,0xFF,0xFF,0xFF,0xFF,0xFF,0xF0
};
static const unsigned char PROGMEM str_12[] =//闹钟标志
{
  /*--  宽度x高度=16x16  --*/
0x00,0x00,0x37,0xEC,0x2F,0xF4,0x5C,0x3A,0x71,0x8E,0xB1,0x8D,0xE1,0x87,0x61,0xA6,
0x61,0xF6,0x70,0x0E,0x30,0x0C,0x30,0x0C,0x18,0x18,0x3F,0xFC,0x37,0xEC,0x00,0x00
};
static const unsigned char PROGMEM str_13[] =//wifi标志
{
  /*--  宽度x高度=16x16  --*/
0x00,0x00,0x00,0x00,0x0F,0xF0,0x38,0x1C,0x60,0x06,0xC7,0xE3,0x0C,0x30,0x10,0x0C,
0x01,0x80,0x07,0xE0,0x0C,0x30,0x00,0x00,0x01,0x80,0x01,0x80,0x00,0x00,0x00,0x00
};
static const unsigned char PROGMEM * str[] =
{
  str_0,str_1,str_2,str_3,str_4,str_5,str_6,str_7,str_8,str_9,str_10,str_11,str_12,str_13
};

void setup() {
  // put your setup code here, to run once:
Serial.begin(9600);
esp_Serial.begin(9600);
display.begin(SSD1306_SWITCHCAPVCC, 0x3C);//OLED芯片地址初始化配置
loop_1.attach(1,plus_1);//注册伪线程loop_1,每隔1秒让函数循环一次
Display_OLED_Host();
connectWifi();//连接无线网
timeClient.begin();//初始化接收时间的客户端
startTCPClient();//初始化TCP客户端的连接

}

void plus_1()
{
  counter_1++;
}







void loop() {
  // put your main code here, to run repeatedly:
  doTCPClientTick();   //和巴法云服务器进行TCP通信
  if(counter_1>=1)
  {
    NTP_Time_Receive();//接收网络时间
    if((H==Hour)&&(M==Minute)&&(S==Second))
       {
        esp_Serial.println("2");
       }
    
    Display_OLED_Time();//OLED显示
    counter_1 = 0;
  }

  
}

void NTP_Time_Receive()
{
  timeClient.update();
  Hour = timeClient.getHours();
  Minute = timeClient.getMinutes();
  Second = timeClient.getSeconds();
  Serial.println("");
  Serial.print(Hour);
  Serial.print(":");
  Serial.print(Minute);
  Serial.print(":");
  Serial.println(Second);
  
}

void Display_OLED_Host()
{
  display.clearDisplay();
  display.setTextSize(1);
  display.setTextColor(WHITE);
  display.drawBitmap(0,0,str[11],128,64,1);
  display.display();
}

void Display_OLED_Time()
{
   display.clearDisplay();
   display.setTextSize(1);
   display.setTextColor(WHITE);
   display.drawBitmap(0,16,str[Hour/10],16,32,1);
   display.drawBitmap(20,16,str[Hour%10],16,32,1);
   display.drawBitmap(46,16,str[Minute/10],16,32,1);
   display.drawBitmap(66,16,str[Minute%10],16,32,1);
   display.drawBitmap(92,16,str[Second/10],16,32,1);
   display.drawBitmap(112,16,str[Second%10],16,32,1);

   display.drawBitmap(37,24,str[10],8,16,1);
   display.drawBitmap(83,24,str[10],8,16,1);
   
  


   if(state == 1)
    {
  
  display.drawBitmap(112,0,str[12],16,16,1);
  display.setTextSize(1);             //设置字体大小
  display.setTextColor(WHITE);        //设置字体颜色白色
  display.setCursor(0,0);             //设置字体的起始位置
  display.print(String_pub);   //输出字符
 
    }
   else
   {
     display.drawBitmap(112,0,str[13],16,16,1);
     
   }

   display.display();
}

void connectWifi(){
   WiFiManager manager;                      //建立manager对象，配网专用
   manager.resetSettings();                  //清除闪存中留下的配网痕迹
   Serial.println("");    
   Serial.println("配网痕迹已擦除!");
   manager.autoConnect("社区智能服务","12345678");
   
   Serial.println("");                       //接下来打印连接上的ssid和ip
   Serial.print("已接入WiFi的名称:");
   Serial.println(WiFi.SSID());              //名称
   Serial.print("已接入WiFi的IP地址:");
   Serial.println(WiFi.localIP());           //IP号
}

void sendtoTCPServer(String p){
  
  if (!TCPclient.connected()) 
  {
    Serial.println("Client is not readly");
    return;
  }
  TCPclient.print(p);
  Serial.println("[Send to TCPServer]:String");
  Serial.println(p);
}
/*
  *初始化和服务器建立连接
*/
void startTCPClient(){
  if(TCPclient.connect(TCP_SERVER_ADDR, atoi(TCP_SERVER_PORT))){
    Serial.print("\nConnected to server:");
    Serial.printf("%s:%d\r\n",TCP_SERVER_ADDR,atoi(TCP_SERVER_PORT));
    
    String tcpTemp="";  //初始化字符串
    tcpTemp = "cmd=1&uid="+UID+"&topic="+TOPIC+"\r\n"; //构建订阅指令
    sendtoTCPServer(tcpTemp); //发送订阅指令
    tcpTemp="";//清空
    
    preTCPConnected = true;
    preHeartTick = millis();
    TCPclient.setNoDelay(true);
  }
  else{
    Serial.print("Failed connected to server:");
    Serial.println(TCP_SERVER_ADDR);
    TCPclient.stop();
    preTCPConnected = false;
  }
  preTCPStartTick = millis();
}
/*
  *检查数据，发送心跳
*/
void doTCPClientTick(){
  if(!TCPclient.connected()){
    if(preTCPConnected == true){

    preTCPConnected = false;
    preTCPStartTick = millis();
    Serial.println(); 
    Serial.println("TCP Client disconnected.");
    TCPclient.stop();
  }
  else if(millis() - preTCPStartTick > 1*1000)//重新连接
    startTCPClient();
  }
  else{
    if (TCPclient.available()) {//收数据
      char c =TCPclient.read();
      TcpClient_Buff +=c;
      TcpClient_BuffIndex++;
      TcpClient_preTick = millis();
      
      if(TcpClient_BuffIndex>=MAX_PACKETSIZE - 1){
        TcpClient_BuffIndex = MAX_PACKETSIZE-2;
        TcpClient_preTick = TcpClient_preTick - 200;
      }
      preHeartTick = millis();
    }
    if(millis() - preHeartTick >= KEEPALIVEATIME){//保持心跳
      preHeartTick = millis();
      Serial.println("--Keep alive:");
      sendtoTCPServer("cmd=0&msg=keep\r\n");
    }
  }
  if((TcpClient_Buff.length() >= 1) && (millis() - TcpClient_preTick>=200))
  {//data ready
    TCPclient.flush();
    Serial.println("Buff");
    Serial.println(TcpClient_Buff);
    if((TcpClient_Buff.indexOf("&msg=#") > 0)) {
      state = 1;
      String String_con = "";
      h = "";
      m = "";
      s = "";
      String mao_hao = "";
      char Receive_Msg[TcpClient_Buff.length()+1];
      strcpy(Receive_Msg,TcpClient_Buff.c_str());
      //
      for(int i = 61;i < 63;i++)
      {
        h += (char)Receive_Msg[i];
      }
      for(int i = 64;i < 66;i++)
      {
        m += (char)Receive_Msg[i];
      }
      for(int i = 67;i < 69;i++)
      {
        s += (char)Receive_Msg[i];
      }
      mao_hao = ":";
       String_con = h + mao_hao + m + mao_hao + s;
       H = h.toInt();
       M = m.toInt();
       S = s.toInt();
       Serial.println(H);
       Serial.println(M);
       Serial.println(S);
        String_pub = String_con;
    }
    else if((TcpClient_Buff.indexOf("&msg=Delete") > 0)){
      esp_Serial.println("3");
    }
    else if((TcpClient_Buff.indexOf("&msg=Config:") > 0))
    {
      Name = "";
      Floor = "";
      char Receive_Cus[TcpClient_Buff.length()+1];
      strcpy(Receive_Cus,TcpClient_Buff.c_str());
      for(int i = 67;i < 75;i++)
      {
        Name += (char)Receive_Cus[i];
      }
      for(int i = 76;i < 82;i++)
      {
        Floor += (char)Receive_Cus[i];
      }
      Serial.print("姓名:");Serial.println(Name);
      Serial.print("楼层:");Serial.println(Floor);
      if((Name=="XiaoMing")&&(Floor=="Floor2"))
      { esp_Serial.println("4"); }//已修改
      else if((Name=="XiaoHong")&&(Floor=="Floor1"))
      { esp_Serial.println("5"); }//已修改
    }
    
   TcpClient_Buff="";
   TcpClient_BuffIndex = 0;
  }
}
